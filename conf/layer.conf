## conf/layer.conf
```bitbake
# We have a conf and classes directory, add to BBPATH
BBPATH .= ":${LAYERDIR}"

# We have recipes-* directories, add to BBFILES
BBFILES += "${LAYERDIR}/recipes-*/*/*.bb \
            ${LAYERDIR}/recipes-*/*/*.bbappend"

BBFILE_COLLECTIONS += "meta-agl-task"
BBFILE_PATTERN_meta-agl-task = "^${LAYERDIR}/"
BBFILE_PRIORITY_meta-agl-task = "65"

LAYERDEPENDS_meta-agl-task = "core"
LAYERSERIES_COMPAT_meta-agl-task = "kirkstone"
```
